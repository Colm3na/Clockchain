#include <MD_MAX72xx.h>
#include <SPI.h>

#define HARDWARE_TYPE MD_MAX72XX::FC16_HW
#define MAX_DEVICES 16 // Número de módulos FC-16
#define CLK_PIN   D5  // o SCK
#define DATA_PIN  D7  // o MOSI
#define CS_PIN    D4  // o SS

// PEGAR AQUÍ LA IMAGEN XBM
uint8_t TEST_bits[] = {
   0x77, 0x05, 0x00, 0x00, 0x21, 0x05, 0x00, 0x00, 0x23, 0x07, 0x00, 0x00,
   0x21, 0x05, 0x00, 0x00, 0x27, 0x05, 0x00, 0x00, 0x00, 0x00, 0x00, 0x00,
   0x00, 0x13, 0x77, 0x01, 0x00, 0x15, 0x15, 0x05, 0x00, 0x13, 0x15, 0x05,
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   0x80, 0xa8, 0x2a, 0xa2, 0xe0, 0xee, 0xee, 0xee };

MD_MAX72XX mx = MD_MAX72XX(HARDWARE_TYPE, CS_PIN, MAX_DEVICES);

void setup() {
  // Inicializamos la librería
  mx.begin();

  /* Especificamos el brillo.
   CUIDADO CON EL CONSUMO!! Alimentar los leds con una fuente
   externa para evitar quemar la placa NodeMCU */
  //mx.control(MD_MAX72XX::INTENSITY, MAX_INTENSITY/4); //  25%
  mx.control(MD_MAX72XX::INTENSITY, MAX_INTENSITY/2); //  50%
  //mx.control(MD_MAX72XX::INTENSITY, MAX_INTENSITY); // 100%
}

void loop() {
  drawXBM(TEST_bits);
  delay(1000);
}

void drawXBM(uint8_t * bytes)
{
  for(int d=0; d<4;d++)
  {
    for(int r=0; r<8;r++)
    {
      for(int c=0; c<4;c++)
        mx.setRow(4*d+c,4*d+c,7-r,bytes[4*r+32*d+c]);
    }
  }
}
